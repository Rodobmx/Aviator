
/*==================================================================================================
Revision History:
                            Modification       Rev.
Author                       Date D/M/Y       Number    Description of Changes
-------------------------   ------------    ----------  -------------------------------------------
N.LEMOINE
R.SAVOURET       				        	     -           Initial version of the file.

==================================================================================================*/


/*==================================================================================================
                                        INCLUDE FILES
==================================================================================================*/
#include "..\header\missile.h"
/*==================================================================================================
                                        LOCAL MACROS
==================================================================================================*/

/*==================================================================================================
                          LOCAL TYPEDEFS (STRUCTURES, UNIONS, ENUMS)
==================================================================================================*/

/*==================================================================================================
                                       LOCAL CONSTANTS
==================================================================================================*/

/*==================================================================================================
                                       LOCAL VARIABLES
==================================================================================================*/

/*==================================================================================================
                                       GLOBAL CONSTANTS
==================================================================================================*/

/*==================================================================================================
                                       GLOBAL VARIABLES
==================================================================================================*/

S_MISSILE missiles[MISSILES_MAX];

/*==================================================================================================
                                   LOCAL FUNCTION PROTOTYPES
==================================================================================================*/

/*==================================================================================================
                                       LOCAL FUNCTIONS
==================================================================================================*/

/*==================================================================================================
                                       GLOBAL FUNCTIONS
==================================================================================================*/

void addMissile(unsigned char x, unsigned char y)
{
   unsigned char i=0;
   
   while(missiles[i].etat != NULL)
   {
     i++;
     if(i == MISSILES_MAX)  //max de missiles atteint
       return;
   }
   
   missiles[i].etat = EXIST;
   missiles[i].x = x;
   missiles[i].y = y;  
}


void avanceMissile(void)
{
  unsigned char i;
  
  for(i=0;i<sizeof(missiles);i++)
  {
    //pas de test sur l'existance du missile
    //gain de temps
    missiles[i].y--;
    
    if(missiles[i].y < BORD_ECRAN)
    {
      missiles[i].etat = NULL;
    }
  }  
}

void detruireMissile(unsigned char x)
{
  unsigned char i;
  
  for(i=0;i<MISSILES_MAX;i++)
  {
    if(missiles[i].x = x)
    {
      missiles[i].etat = NULL;
    }
  }
}


void afficherMissile()
{
    unsigned char i;
    for(i=0;i<sizeof(missiles);i++)
    {
      if(missiles[i].etat == EXIST)
      {
        LCD_BlitRawBuffer(missiles[i].x, missiles[i].y, MISSILE_X_LENGTH,MISSILE_Y_LENGTH,SPACE_MISSILE);
      }
    }
}


/*==================================================================================================
                                         END OF FILE
==================================================================================================*/

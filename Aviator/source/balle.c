
/*==================================================================================================
Revision History:
                            Modification       Rev.
Author                       Date D/M/Y       Number    Description of Changes
-------------------------   ------------    ----------  -------------------------------------------
N.LEMOINE
R.SAVOURET       				        	     -           Initial version of the file.

==================================================================================================*/


/*==================================================================================================
                                        INCLUDE FILES
==================================================================================================*/
#include "..\header\balle.h"
/*==================================================================================================
                                        LOCAL MACROS
==================================================================================================*/

/*==================================================================================================
                          LOCAL TYPEDEFS (STRUCTURES, UNIONS, ENUMS)
==================================================================================================*/

/*==================================================================================================
                                       LOCAL CONSTANTS
==================================================================================================*/

/*==================================================================================================
                                       LOCAL VARIABLES
==================================================================================================*/

/*==================================================================================================
                                       GLOBAL CONSTANTS
==================================================================================================*/
#define STEP_BALLE 2            // Vitesse des balles (pixel / iterration de timer)
/*==================================================================================================
                                       GLOBAL VARIABLES
==================================================================================================*/

S_BALLE balles[BALLES_MAX];     // Tableau de balles

/*==================================================================================================
                                   LOCAL FUNCTION PROTOTYPES
==================================================================================================*/

/*==================================================================================================
                                       LOCAL FUNCTIONS
==================================================================================================*/

/*==================================================================================================
                                       GLOBAL FUNCTIONS
==================================================================================================*/

void addBalle(unsigned char x, unsigned char y)
{
   unsigned char i=0;
   
   // Recherche une position de balle disponible
   while(balles[i].etat != NULL)
   {
     i++;
     if(i == BALLES_MAX)  //max de missiles atteint
       return;
   }
   
   // créer une balle a la position donnée
   balles[i].etat = EXIST;
   balles[i].x = x;
   balles[i].y = y;  
}


void avanceBalles(void)
{
  unsigned char i;
  
  for(i=0;i<BALLES_MAX;i++)
  {
    balles[i].y -= STEP_BALLE;
    
    // Suppression des balles depassé
    if((balles[i].y < BORD_ECRAN) && (balles[i].etat == EXIST))
    {
      detruireBalle(i);
    }
  }  
}

void detruireBalle(unsigned char i)
{
  balles[i].etat = NULL;
  LCD_DrawRect(balles[i].y,balles[i].x, balles[i].y+BALLES_Y_LENGTH,balles[i].x+BALLES_X_LENGTH,1, BLUE);
}


void afficherBalles()
{
    unsigned char i;
    // Affiche chaque balle si elle existe
    for(i=0;i<BALLES_MAX;i++)
    {
      if(balles[i].etat == EXIST)
      {
        LCD_BlitRawBuffer(balles[i].y, balles[i].x,BALLES_Y_LENGTH,BALLES_X_LENGTH,SPACE_BALLE);
      }
    }
}


/*==================================================================================================
                                         END OF FILE
==================================================================================================*/
